## shields/go60_dongle/Kconfig.defconfig
```kconfig
if SHIELD_GO60_DONGLE

# Max 16 characters
config ZMK_KEYBOARD_NAME
    default "Go60 Dongle"

config ZMK_SPLIT
    default y

config ZMK_SPLIT_ROLE_CENTRAL
    default y

# Two peripheral halves connect to this one central.
config ZMK_SPLIT_BLE_CENTRAL_PERIPHERALS
    default 2

# ZMK_SPLIT_BLE_CENTRAL_PERIPHERALS + desired number of host BT profiles (5).
config BT_MAX_CONN
    default 7

config BT_MAX_PAIRED
    default 7

endif
```

## shields/go60_lh_peripheral/Kconfig.shield
```kconfig
config SHIELD_GO60_LH_PERIPHERAL
    def_bool $(shields_list_contains,go60_lh_peripheral)
```

## shields/go60_rh_peripheral/Kconfig.shield
```kconfig
config SHIELD_GO60_RH_PERIPHERAL
    def_bool $(shields_list_contains,go60_rh_peripheral)
```
